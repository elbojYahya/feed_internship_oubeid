## amx-greeter-plugin/Config.in
```kconfig
config PACKAGE_amx-greeter-plugin
    tristate
    select SAH_AMX_GREETER_PLUGIN

if PACKAGE_amx-greeter-plugin

menu "Select amx-greeter-plugin build options"
    depends on PACKAGE_amx-greeter-plugin

config SAH_AMX_GREETER_PLUGIN
    bool "Build amx-greeter-plugin itself"
    default y

config SAH_AMX_GREETER_PLUGIN_ORDER
    int "Start up order for the GREETER plugin"
    default 99

endmenu

endif
```
